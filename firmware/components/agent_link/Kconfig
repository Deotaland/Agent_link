## firmware/components/agent_link/Kconfig
```kconfig
menu "agent_link SDK"

config AGENT_LINK_OTA_ENABLE
    bool "Enable OTA firmware upgrade over the App link"
    default y
    help
        Handle 0x37 StartOtaUpgrade / 0x56 AbortOtaUpgrade and stream the new firmware
        in over the L2CAP data channel, then verify SHA-256 and reboot into it.
        the official App upgrades agent_link devices with the code path it already ships.
        Requires an OTA-capable partition table (ota_0/ota_1 + otadata).

if AGENT_LINK_OTA_ENABLE

config AGENT_LINK_OTA_REQUIRE_NEWER_VERSION
    bool "Reject firmware that is not strictly newer"
    default n
    help
        y = rule: the version in 0x37 must be strictly greater
        than the running one (major.minor.patch), otherwise the device answers 2030
        OtaVersionIncompat. Same version or a downgrade is refused.

        n (default) = accept any version. This is what lets a bench device be flashed
        back and forth between agent_link firmware (2.x) and the production 1.7.x image
        without a serial cable. The App still decides what it offers.

config AGENT_LINK_OTA_REQUIRE_MODEL_MATCH
    bool "Reject firmware built for a different device model"
    default y
    help
        The App may append a model string to 0x37. When it does and this is enabled, it
        must equal this device's model (agent_link_config_t.model) or the device answers
        2037 OtaModelMismatch — this is what stops a build for other hardware from being
        flashed onto this one. An App that sends no model is always allowed through
        (older App versions)

config AGENT_LINK_OTA_RX_BUFFER_KB
    int "OTA receive buffer (KB)"
    range 16 128
    default 32
    help
        Ring buffer between the link RX callback and the flash-writing worker. Allocated
        in PSRAM when available, otherwise internal RAM. The link is back-pressured (the
        peer stops getting credit) whenever less than a quarter of it is free, so a
        smaller buffer costs throughput, never correctness.

endif # AGENT_LINK_OTA_ENABLE

endmenu
```

## firmware/main/Kconfig.profiles
```kconfig
choice AGENT_LINK_FIRMWARE_SELECTION
    prompt "Firmware profile"
    default AGENT_LINK_PROFILE_ROROLEE_BLE if IDF_TARGET_ESP32S3
    default AGENT_LINK_PROFILE_AI_PASSPORT_BLE if IDF_TARGET_ESP32C3
    default AGENT_LINK_PROFILE_PAPER_S31_WIFI if IDF_TARGET_ESP32S31
    help
        Select a firmware for the current target chip, then save and build.
        The build applies the profile's own board and memory settings.
        To switch chips, use the menu in tools/build_firmware.py.

    config AGENT_LINK_PROFILE_PAPER_S31_WIFI
        bool "paper-s31-wifi (WIFI)"
        depends on IDF_TARGET_ESP32S31

    config AGENT_LINK_PROFILE_KORVO_BLE
        bool "korvo-ble (BLE)"
        depends on IDF_TARGET_ESP32S3

    config AGENT_LINK_PROFILE_KORVO_WIFI
        bool "korvo-wifi (WIFI)"
        depends on IDF_TARGET_ESP32S3

    config AGENT_LINK_PROFILE_ROROLEE_BLE
        bool "rorolee-ble (BLE)"
        depends on IDF_TARGET_ESP32S3

    config AGENT_LINK_PROFILE_WORK_BADGE_BLE
        bool "work-badge-ble (BLE)"
        depends on IDF_TARGET_ESP32S3

    config AGENT_LINK_PROFILE_AI_PASSPORT_BLE
        bool "ai-passport-ble (BLE)"
        depends on IDF_TARGET_ESP32C3

    config AGENT_LINK_PROFILE_M5STACK_STOPWATCH_BLE
        bool "m5stack-stopwatch-ble (BLE)"
        depends on IDF_TARGET_ESP32S3

    config AGENT_LINK_PROFILE_M5STACK_STOPWATCH_WIFI
        bool "m5stack-stopwatch-wifi (WIFI)"
        depends on IDF_TARGET_ESP32S3

    config AGENT_LINK_PROFILE_GC2145_CAMERA_BLE
        bool "gc2145-camera-ble (BLE)"
        depends on IDF_TARGET_ESP32S3

    config AGENT_LINK_PROFILE_ES8311_VOICE_BLE
        bool "es8311-voice-ble (BLE)"
        depends on IDF_TARGET_ESP32S3

    config AGENT_LINK_PROFILE_ES8311_ASR_BLE
        bool "es8311-asr-ble (BLE)"
        depends on IDF_TARGET_ESP32S3

    config AGENT_LINK_PROFILE_ROROLEE_MUSE
        bool "rorolee-muse (MUSE)"
        depends on IDF_TARGET_ESP32S3

    config AGENT_LINK_PROFILE_WOWNNY_MUSE
        bool "wownny-muse (MUSE)"
        depends on IDF_TARGET_ESP32S3

    config AGENT_LINK_PROFILE_WOWNNY_OLD_MUSE
        bool "wownny-old-muse (MUSE)"
        depends on IDF_TARGET_ESP32S3

endchoice

config AGENT_LINK_FIRMWARE_PROFILE
    string
    default "paper-s31-wifi" if AGENT_LINK_PROFILE_PAPER_S31_WIFI
    default "korvo-ble" if AGENT_LINK_PROFILE_KORVO_BLE
    default "korvo-wifi" if AGENT_LINK_PROFILE_KORVO_WIFI
    default "rorolee-ble" if AGENT_LINK_PROFILE_ROROLEE_BLE
    default "work-badge-ble" if AGENT_LINK_PROFILE_WORK_BADGE_BLE
    default "ai-passport-ble" if AGENT_LINK_PROFILE_AI_PASSPORT_BLE
    default "m5stack-stopwatch-ble" if AGENT_LINK_PROFILE_M5STACK_STOPWATCH_BLE
    default "m5stack-stopwatch-wifi" if AGENT_LINK_PROFILE_M5STACK_STOPWATCH_WIFI
    default "gc2145-camera-ble" if AGENT_LINK_PROFILE_GC2145_CAMERA_BLE
    default "es8311-voice-ble" if AGENT_LINK_PROFILE_ES8311_VOICE_BLE
    default "es8311-asr-ble" if AGENT_LINK_PROFILE_ES8311_ASR_BLE
    default "rorolee-muse" if AGENT_LINK_PROFILE_ROROLEE_MUSE
    default "wownny-muse" if AGENT_LINK_PROFILE_WOWNNY_MUSE
    default "wownny-old-muse" if AGENT_LINK_PROFILE_WOWNNY_OLD_MUSE
```

## firmware/main/Kconfig.projbuild
```kconfig
menu "Agent Link Device"

rsource "Kconfig.profiles"

config BOARD_TYPE_WAVESHARE_EPAPER_397_WIFI
    bool
    default y if AGENT_LINK_FIRMWARE_PROFILE = "waveshare-epaper-397-wifi"

config BOARD_TYPE_PAPER_S31_WIFI
    bool
    default y if AGENT_LINK_FIRMWARE_PROFILE = "paper-s31-wifi"

config PAPER_S31_DISPLAY_DIAGNOSTIC
    bool "S31: display one static diagnostic frame, then hold"
    depends on BOARD_TYPE_PAPER_S31_WIFI
    default n
    help
        Boot into a single white-background display test. After one attempt,
        including failure, no display writes or retries occur until reboot.
        Menu input and application timers are disabled; network setup/auth
        tasks remain running. Log frame statistics and display BUSY timings
        without changing the panel register values or adding busy waits.

config BOARD_TYPE_ROROLEE_S3
    bool
    default y if AGENT_LINK_FIRMWARE_PROFILE = "rorolee-ble"

config BOARD_TYPE_ESP32P4_WAVESHARE
    bool

config BOARD_TYPE_ESP32S3_ES8311_VOICE
    bool
    default y if AGENT_LINK_FIRMWARE_PROFILE = "es8311-voice-ble"

config BOARD_TYPE_ESP32S3_ES8311_ASR
    bool
    default y if AGENT_LINK_FIRMWARE_PROFILE = "es8311-asr-ble"

config BOARD_TYPE_ESP32S3_GC2145_CAMERA
    bool
    default y if AGENT_LINK_FIRMWARE_PROFILE = "gc2145-camera-ble"

config BOARD_TYPE_ESP32S3_KORVO
    bool
    default y if AGENT_LINK_FIRMWARE_PROFILE = "korvo-ble"

config BOARD_TYPE_ESP32S3_KORVO_CLOUD
    bool
    default y if AGENT_LINK_FIRMWARE_PROFILE = "korvo-wifi"
    select LV_FONT_MONTSERRAT_28
    select MBEDTLS_DYNAMIC_BUFFER
    select MBEDTLS_DYNAMIC_FREE_CONFIG_DATA
    select SPIRAM_TRY_ALLOCATE_WIFI_LWIP
    help
        The korvo-wifi profile provides the platform touch UI and realtime voice.
        Use korvo-ble for the phone App firmware on the same hardware.

config BOARD_TYPE_ESP32S3_WORK_BADGE
    bool
    default y if AGENT_LINK_FIRMWARE_PROFILE = "work-badge-ble"
    select LV_FONT_MONTSERRAT_20
    select LV_FONT_MONTSERRAT_28

config BOARD_TYPE_ROROLEE_MUSE
    bool
    default y if AGENT_LINK_FIRMWARE_PROFILE = "rorolee-muse"
    select LV_FONT_MONTSERRAT_20
    select LV_FONT_MONTSERRAT_28
    select LV_USE_TINY_TTF
    select SPIRAM_TRY_ALLOCATE_WIFI_LWIP
    help
        The rorolee-s3 PCB with an LVGL screen: link status, hold BOOT to talk, the
        answer as text. The rorolee-muse profile pairs through the Muse app.

config BOARD_TYPE_WOWNNY_MUSE
    bool
    default y if AGENT_LINK_FIRMWARE_PROFILE = "wownny-muse"
    select LV_FONT_MONTSERRAT_12
    select SPIRAM_TRY_ALLOCATE_WIFI_LWIP
    help
        WOWNNY: the rorolee PCB with a GC9D01 round TFT instead of the SH8501 AMOLED.
        Same features as RoRoLee Muse, with a UI for the round screen. Panel on GPIO4-7
        and GPIO43, backlight on GPIO46, 32.768 kHz crystal on GPIO15/16.

config BOARD_TYPE_WOWNNY_OLD_MUSE
    bool
    default y if AGENT_LINK_FIRMWARE_PROFILE = "wownny-old-muse"
    select LV_FONT_MONTSERRAT_12
    select SPIRAM_TRY_ALLOCATE_WIFI_LWIP
    help
        The old WOWNNY board, built from boards/wownny-muse like WWY-01. Differences:
        panel on GPIO4-7/15 and powered from GPIO46 (power-cycled at boot), no 32.768 kHz
        crystal (RTC on the internal RC), SD D3 on GPIO16, volume keys swapped.

config BOARD_TYPE_M5STACK_STOPWATCH
    bool
    default y if AGENT_LINK_FIRMWARE_PROFILE = "m5stack-stopwatch-ble"
    select LV_FONT_MONTSERRAT_20
    select LV_FONT_MONTSERRAT_24
    select LV_FONT_MONTSERRAT_28
    select LV_FONT_MONTSERRAT_48
    help
        M5Stack StopWatch (ESP32-S3R8, SKU C152): hold the yellow key to talk to the agent,
        replies on the speaker, the link status on the round screen.
        The supported profile is m5stack-stopwatch-ble.

config BOARD_TYPE_OJBADGE_WIFI
    bool
    default y if AGENT_LINK_FIRMWARE_PROFILE = "ojbadge-wifi"
    select LV_FONT_MONTSERRAT_20
    select LV_FONT_MONTSERRAT_28
    help
        OJBadge 240x240 circular touch UI and local ESP-NOW friendship.
        No platform startup, provisioning, cloud authentication or audio.

config BOARD_TYPE_WAVESHARE_AMOLED_175_WIFI
    bool
    default y if AGENT_LINK_FIRMWARE_PROFILE = "waveshare-amoled-175-wifi"
    select LV_FONT_MONTSERRAT_20
    select LV_FONT_MONTSERRAT_24
    select LV_FONT_MONTSERRAT_48
    select MBEDTLS_DYNAMIC_BUFFER
    select MBEDTLS_DYNAMIC_FREE_CONFIG_DATA
    select SPIRAM_TRY_ALLOCATE_WIFI_LWIP
    help
        Waveshare ESP32-S3-Touch-AMOLED-1.75C: circular touch UI, status ring,
        WiFi setup, activation and realtime voice with the platform-bound Agent.

config BOARD_TYPE_M5STACK_STOPWATCH_WIFI
    bool
    default y if AGENT_LINK_FIRMWARE_PROFILE = "m5stack-stopwatch-wifi"
    select LV_FONT_MONTSERRAT_20
    select LV_FONT_MONTSERRAT_24
    select LV_FONT_MONTSERRAT_28
    select LV_FONT_MONTSERRAT_48
    select MBEDTLS_DYNAMIC_BUFFER
    select MBEDTLS_DYNAMIC_FREE_CONFIG_DATA
    select SPIRAM_TRY_ALLOCATE_WIFI_LWIP
    help
        StopWatch WiFi: hotspot setup, activation code, platform-bound agent,
        conversation management and realtime voice. Use m5stack-stopwatch-ble for the phone App firmware.

config BOARD_TYPE_FOLOTOY_AI_PASSPORT
    bool
    default y if AGENT_LINK_FIRMWARE_PROFILE = "ai-passport-ble"
    help
        FoloToy AI Passport wearable: ESP32-C3, 8 MB flash, no PSRAM. Hold the OK key to
        talk to the agent over BLE; replies play on the speaker. Screen colour shows link
        status. Use the ai-passport-ble profile. Pins match FoloToy ai-passport BSP.

config BOARD_TYPE_FOLOTOY_AI_PASSPORT_WIFI
    bool
    default y if AGENT_LINK_FIRMWARE_PROFILE = "ai-passport-wifi"

config AGENT_LINK_TRANSPORT_BLE
    bool
    default y if BOARD_TYPE_ESP32S3_KORVO
    default y if BOARD_TYPE_ROROLEE_S3
    default y if BOARD_TYPE_ESP32S3_WORK_BADGE
    default y if BOARD_TYPE_FOLOTOY_AI_PASSPORT
    default y if BOARD_TYPE_M5STACK_STOPWATCH
    default y if BOARD_TYPE_ESP32S3_GC2145_CAMERA
    default y if BOARD_TYPE_ESP32S3_ES8311_VOICE
    default y if BOARD_TYPE_ESP32S3_ES8311_ASR

config AGENT_LINK_TRANSPORT_WIFI
    bool
    default y if BOARD_TYPE_FOLOTOY_AI_PASSPORT_WIFI
    default y if BOARD_TYPE_WAVESHARE_EPAPER_397_WIFI
    default y if BOARD_TYPE_PAPER_S31_WIFI
    default y if BOARD_TYPE_ESP32S3_KORVO_CLOUD
    default y if BOARD_TYPE_M5STACK_STOPWATCH_WIFI
    default y if BOARD_TYPE_WAVESHARE_AMOLED_175_WIFI

config AGENT_LINK_TRANSPORT_MUSE
    bool
    default y if BOARD_TYPE_ROROLEE_MUSE
    default y if BOARD_TYPE_WOWNNY_MUSE
    default y if BOARD_TYPE_WOWNNY_OLD_MUSE
    select MBEDTLS_HKDF_C

endmenu
```
