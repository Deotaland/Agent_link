## firmware/main/Kconfig.build_target
```kconfig
choice AGENT_LINK_BUILD_TARGET
    prompt "Firmware build target"
    default AGENT_LINK_BUILD_APPLICATION
    help
        Application mode selects a firmware profile. Factory mode selects only
        hardware with a registered board-bound Factory. The two selectors are
        separate, and Factory is offered only on chips with an adapted board.

    config AGENT_LINK_BUILD_APPLICATION
        bool "Application firmware (selected profile)"

    config AGENT_LINK_BUILD_FACTORY
        bool "Factory firmware (bound to selected board)"
        depends on AGENT_LINK_CHIP_FACTORY_AVAILABLE

endchoice

rsource "Kconfig.factories"
```

## firmware/recovery/sdgoods-esp32s3/sdkconfig.defaults
```kconfig
CONFIG_IDF_TARGET="esp32s3"
CONFIG_ESPTOOLPY_FLASHSIZE_32MB=y
CONFIG_IDF_EXPERIMENTAL_FEATURES=y
CONFIG_BOOTLOADER_CACHE_32BIT_ADDR_QUAD_FLASH=y
CONFIG_PARTITION_TABLE_CUSTOM=y
CONFIG_PARTITION_TABLE_CUSTOM_FILENAME="../../partitions/sdgoods-v5.csv"
CONFIG_COMPILER_OPTIMIZATION_SIZE=y
CONFIG_ESP_CONSOLE_USB_SERIAL_JTAG=y
CONFIG_SPI_FLASH_DANGEROUS_WRITE_ALLOWED=y
CONFIG_ESP_MAIN_TASK_STACK_SIZE=8192
CONFIG_LOG_DEFAULT_LEVEL_WARN=y
# Match the parent's retained-memory layout and consume its cold key-hold proof.
CONFIG_BOOTLOADER_FACTORY_RESET=y
CONFIG_BOOTLOADER_NUM_PIN_FACTORY_RESET=6
CONFIG_BOOTLOADER_FACTORY_RESET_PIN_LOW=y
CONFIG_BOOTLOADER_HOLD_TIME_GPIO=3
CONFIG_BOOTLOADER_OTA_DATA_ERASE=y
CONFIG_BOOTLOADER_DATA_FACTORY_RESET=""
```
